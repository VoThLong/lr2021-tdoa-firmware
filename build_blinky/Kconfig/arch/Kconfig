## build_blinky/Kconfig/arch/Kconfig
```kconfig
# Load Zephyr Arch Kconfig descriptions.
osource "/home/dashtrad/lora_usp_workspace/zephyr/arch/rx/Kconfig"
osource "/home/dashtrad/lora_usp_workspace/zephyr/arch/x86/Kconfig"
osource "/home/dashtrad/lora_usp_workspace/zephyr/arch/xtensa/Kconfig"
osource "/home/dashtrad/lora_usp_workspace/zephyr/arch/sparc/Kconfig"
osource "/home/dashtrad/lora_usp_workspace/zephyr/arch/riscv/Kconfig"
osource "/home/dashtrad/lora_usp_workspace/zephyr/arch/posix/Kconfig"
osource "/home/dashtrad/lora_usp_workspace/zephyr/arch/openrisc/Kconfig"
osource "/home/dashtrad/lora_usp_workspace/zephyr/arch/mips/Kconfig"
osource "/home/dashtrad/lora_usp_workspace/zephyr/arch/arm64/Kconfig"
osource "/home/dashtrad/lora_usp_workspace/zephyr/arch/arm/Kconfig"
osource "/home/dashtrad/lora_usp_workspace/zephyr/arch/arc/Kconfig"
```

## build_blinky/Kconfig/boards/Kconfig.nucleo_l073rz
```kconfig
# Load board Kconfig descriptions.
osource "/home/dashtrad/lora_usp_workspace/zephyr/boards/st/nucleo_l073rz/Kconfig.nucleo_l073rz"
```

## build_blinky/Kconfig/boards/Kconfig.sysbuild
```kconfig
# Load Sysbuild board Kconfig descriptions.
osource "/home/dashtrad/lora_usp_workspace/zephyr/boards/st/nucleo_l073rz/Kconfig.sysbuild"
```
